## Kconfig
```kconfig
mainmenu "BlockOS Kernel Configuration"

source "Kconfig.arch"
source "Kconfig.kernel"
source "Kconfig.drivers"
source "Kconfig.fs"
source "Kconfig.network"
source "Kconfig.gui"
source "Kconfig.libc"
```

## Kconfig.arch
```kconfig
choice
    prompt "Target architecture"
    default ARCH_X86_64

config ARCH_X86_64
    bool "x86-64"

config ARCH_ESP32
    bool "ESP32 (classic Xtensa LX6)"

endchoice

choice
    prompt "x86-64 boot method"
    default BOOT_UEFI
    depends on ARCH_X86_64

config BOOT_UEFI
    bool "UEFI / GNU-EFI"

config BOOT_GRUB
    bool "GRUB / Multiboot2 (experimental)"
    help
      The Kconfig entry is reserved for the BlockOS GRUB/Multiboot2
      boot path. The current production x86-64 build still uses GNU-EFI.

endchoice

menu "ESP32 platform"
    depends on ARCH_ESP32

config ESP32_CLASSIC
    bool "Classic ESP32 support"
    default y

endmenu
```

## Kconfig.gui
```kconfig
menu "Graphics / GUI"

config GUI_FRAMEBUFFER
    bool "Framebuffer GUI"
    default y

config GUI_X11
    bool "BlockOS X11 server"
    default y
    depends on GUI_FRAMEBUFFER

config GUI_WINDOW_MANAGER
    bool "Window manager support"
    default y
    depends on GUI_X11

config GUI_WINDOWMAKER
    bool "Window Maker integration"
    default y
    depends on GUI_WINDOW_MANAGER

endmenu
```

## Kconfig.kernel
```kconfig
menu "General kernel setup"

config KERNEL_PREEMPT
    bool "Preemptive scheduler"
    default y

config KERNEL_SMP
    bool "SMP / multicore support"
    default y
    depends on ARCH_X86_64

config KERNEL_USERMODE
    bool "Ring3 / userspace support"
    default y
    depends on ARCH_X86_64

config KERNEL_ELF
    bool "ELF loader"
    default y

config KERNEL_SYSCALLS
    bool "System call interface"
    default y
    depends on KERNEL_USERMODE

config KERNEL_SANDBOX
    bool "Process sandbox / isolation"
    default y
    depends on KERNEL_USERMODE

config KERNEL_IO_URING
    bool "io_uring support"
    default y
    depends on ARCH_X86_64

config KERNEL_DEBUG
    bool "Kernel debug diagnostics"
    default y

endmenu
```

## Kconfig.libc
```kconfig
menu "C Library / userspace"

config LIBC
    bool "BlockOS libc"
    default y

config LIBC_STRING
    bool "String functions"
    default y
    depends on LIBC

config LIBC_MEMORY
    bool "Memory functions"
    default y
    depends on LIBC

config LIBC_STDIO
    bool "stdio"
    default y
    depends on LIBC

config LIBC_STDLIB
    bool "stdlib"
    default y
    depends on LIBC

config LIBC_UNISTD
    bool "POSIX unistd"
    default y
    depends on LIBC

config LIBC_PTHREAD
    bool "pthread compatibility"
    default n
    depends on LIBC

config LIBC_MATH
    bool "Math library"
    default y
    depends on LIBC

config USERSPACE_LDSO
    bool "Dynamic loader (ld.so)"
    default y
    depends on ARCH_X86_64

config USERSPACE_RING3_TESTS
    bool "Ring3 userspace tests"
    default y
    depends on ARCH_X86_64 && KERNEL_USERMODE

endmenu
```

## Kconfig.network
```kconfig
menu "Networking"

config NET
    bool "Networking support"
    default y

if NET

config NET_IPV4
    bool "IPv4"
    default y

config NET_TCP
    bool "TCP"
    default y

config NET_UDP
    bool "UDP"
    default y

config NET_DNS
    bool "DNS"
    default y

config NET_DHCP
    bool "DHCP"
    default y

config NET_SOCKETS
    bool "Sockets"
    default y

endif

endmenu
```
